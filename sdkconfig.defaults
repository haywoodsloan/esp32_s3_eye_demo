## sdkconfig.defaults
```kconfig
# Target
CONFIG_IDF_TARGET="esp32s3"

# 8 MB flash on the ESP32-S3-EYE
CONFIG_ESPTOOLPY_FLASHSIZE_8MB=y
CONFIG_ESPTOOLPY_FLASHSIZE="8MB"
CONFIG_ESPTOOLPY_HEADER_FLASHSIZE_UPDATE=y

# Custom partition table: 6 MB app + 1 MB SPIFFS for the face DB
CONFIG_PARTITION_TABLE_CUSTOM=y
CONFIG_PARTITION_TABLE_CUSTOM_FILENAME="partitions.csv"

# ESP-DL uses C++ exceptions in a few error paths
CONFIG_COMPILER_CXX_EXCEPTIONS=y

# ESP-WHO face detection (ESPDet PICO 224x224 single-stage detector)
# flashed to its own partition. FLASH_PARTITION (rather than
# FLASH_RODATA) avoids a PlatformIO + esp-dl CMake bug where the
# BUILD_DIR relative path gets doubled when generating the embedded-
# binary .S file. It also keeps the app binary small.
#
# The two-stage MSR+MNP cascade that was previously the default got
# benchmarked at mAP50-95 = 0.367 on Espressif's val set; ESPDet PICO
# 224 hits 0.495 -- a sizeable accuracy improvement that catches
# glasses, off-angle, far-range, and harsh-lighting cases the cascade
# was missing. The trade is ~3x inference cost (~130 ms vs ~43 ms),
# which we accept here.
CONFIG_HUMAN_FACE_DETECT_MODEL_IN_FLASH_PARTITION=y
CONFIG_FLASH_ESPDET_PICO_224_224_FACE=y
CONFIG_ESPDET_PICO_224_224_FACE=y
CONFIG_DEFAULT_HUMAN_FACE_DETECT_MODEL=1

# ESP-WHO face recognition (MobileFaceNet, smaller/faster of the two) also
# in its own partition for the same reason.
CONFIG_HUMAN_FACE_FEAT_MODEL_IN_FLASH_PARTITION=y
CONFIG_HUMAN_FACE_FEAT_MFN_S8_V1=y
CONFIG_FLASH_HUMAN_FACE_FEAT_MFN_S8_V1=y

# 8 MB octal PSRAM @ 80 MHz (required by esp32-camera for frame buffers)
CONFIG_SPIRAM=y
CONFIG_SPIRAM_MODE_OCT=y
CONFIG_SPIRAM_SPEED_80M=y
CONFIG_SPIRAM_USE_MALLOC=y
CONFIG_SPIRAM_MALLOC_ALWAYSINTERNAL=16384

# Run the CPU at full speed
CONFIG_ESP_DEFAULT_CPU_FREQ_MHZ_240=y
CONFIG_ESP_DEFAULT_CPU_FREQ_MHZ=240

# Optimise for performance over size
CONFIG_COMPILER_OPTIMIZATION_PERF=y

# Test #11 (low-level perf pass): bumped L1 cache sizes/line widths
# were attempted here but bricked boot -- the larger D-cache eats
# into internal SRAM that the camera HAL / display front buffer
# require. Keep defaults (16 KB I / 32 KB D, 32-byte lines). The
# -O3 + unroll-loops + hot attributes inside face_ai.cpp itself
# remain in effect via #pragma in that translation unit.

# Pin the camera capture task to core 0; the render task runs on core 1.
CONFIG_CAMERA_CORE0=y

# Brownout detector: SEL_4 (2.79 V) is the practical floor we'll
# tolerate, prioritising memory safety over transient tolerance.
#
# Component floors for reference:
#   * ST7789 LCD: VCC >= 2.4 V.
#   * OV2640 camera: AVDD >= 2.5 V.
#   * ESP32-S3: VDD33 spec min 3.0 V; PSRAM / flash interfaces become
#     unreliable below ~2.9 V (silent corruption rather than a clean
#     reset).
#
# The SoC is the actual limit, not the peripherals. SEL_4 is already
# below the S3's nominal spec, so a brownout *trigger* at this level
# is still well-justified -- the rail has dipped further than the chip
# is meant to operate at, and a clean reset is far better than risking
# scrambled PSRAM contents. SEL_3 / SEL_2 would only buy more
# transient tolerance at the cost of letting the chip keep running
# into undefined-behaviour territory. Don't.
#
# If you see *spurious* brownouts on a known-good supply, the right
# fix is usually a thicker USB cable / better hub / a powered hub,
# not lowering this threshold further.
#
# Levels (S3): 7=3.19 V (IDF default), 6=3.05 V, 5=2.92 V, 4=2.79 V,
# 3=2.66 V, 2=2.52 V, 1=2.39 V.
CONFIG_ESP_BROWNOUT_DET_LVL_SEL_7=n
CONFIG_ESP_BROWNOUT_DET_LVL_SEL_4=y
CONFIG_ESP_BROWNOUT_DET_LVL=4
```

## sdkconfig.defaults.pico224
```kconfig
# Overlay applied on top of sdkconfig.defaults for the
# `esp32-s3-pico224` PlatformIO env. Only the model-selection and
# partition-table settings differ from the main build.

# Use the bigger 512 KB face-det partition table so the espdet_pico
# 224x224 .espdl blob fits.
CONFIG_PARTITION_TABLE_CUSTOM_FILENAME="partitions.pico224.csv"

# Replace MSR+MNP with ESPDET_PICO_224_224_FACE. Explicit "not set"
# lines are required to defeat the defaults from sdkconfig.defaults.
# CONFIG_FLASH_HUMAN_FACE_DETECT_MSRMNP_S8_V1 is not set
# CONFIG_HUMAN_FACE_DETECT_MSRMNP_S8_V1 is not set
CONFIG_FLASH_ESPDET_PICO_224_224_FACE=y
CONFIG_ESPDET_PICO_224_224_FACE=y
CONFIG_DEFAULT_HUMAN_FACE_DETECT_MODEL=1
```
